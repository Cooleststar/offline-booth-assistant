/dts-v1/;
/plugin/;

/ {
    compatible = "rockchip,rk3566", "rockchip,rk3568";

    fragment@0 {
        target = <&spi3>;
        __overlay__ {
            status = "okay";
            pinctrl-names = "default";
            pinctrl-0 = <&spi3m1_cs0 &spi3m1_pins>;
            #address-cells = <1>;
            #size-cells = <0>;

            spidev@0 {
                compatible = "rohm,dh2228fv";
                status = "okay";
                reg = <0>;
                spi-max-frequency = <50000000>;
            };
        };
    };
};
